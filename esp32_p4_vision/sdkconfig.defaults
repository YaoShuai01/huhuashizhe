## esp32_p4_vision/sdkconfig.defaults
```kconfig
# ESP32-P4-Core-DEV-KIT + OV5647 MIPI 采集最小验证工程
CONFIG_IDF_TARGET="esp32p4"

# PSRAM / Flash
CONFIG_SPIRAM=y
CONFIG_SPIRAM_SPEED_200M=y
CONFIG_SPIRAM_XIP_FROM_PSRAM=y
CONFIG_CACHE_L2_CACHE_256KB=y
CONFIG_CACHE_L2_CACHE_LINE_128B=y
CONFIG_ESPTOOLPY_FLASHMODE_QIO=y
CONFIG_ESPTOOLPY_FLASHSIZE_16MB=y
CONFIG_COMPILER_OPTIMIZATION_PERF=y

# 控制台走板载 CH343 UART 口，方便看日志
CONFIG_ESP_CONSOLE_UART_DEFAULT=y
# USB-Serial-JTAG 口留给原始 JPEG 传输，不再做二级控制台
CONFIG_ESP_CONSOLE_SECONDARY_NONE=y
CONFIG_BOOTLOADER_LOG_LEVEL_WARN=y
CONFIG_BOOTLOADER_LOG_LEVEL=2

CONFIG_ESP_MAIN_TASK_STACK_SIZE=10240
CONFIG_FREERTOS_HZ=1000

# MIPI-CSI + ISP + OV5647
CONFIG_ESP_VIDEO_ENABLE_MIPI_CSI_VIDEO_DEVICE=y
CONFIG_ESP_VIDEO_ENABLE_ISP_PIPELINE_CONTROLLER=y
CONFIG_CAMERA_OV5647=y
CONFIG_CAMERA_OV5647_AUTO_DETECT_MIPI_INTERFACE_SENSOR=y
# 实时预览用 1280x960 RAW10 binning 45fps（USB 带宽内能到 8~12fps）
# 1080p 模式保留编译，后续可切
CONFIG_CAMERA_OV5647_MIPI_RAW10_1280X960_BINNING_45FPS=y
CONFIG_CAMERA_OV5647_MIPI_RAW10_1920X1080_30FPS=y
CONFIG_CAMERA_OV5647_MIPI_DEFAULT_FMT_RAW10_1280X960_BINNING_45FPS=y

# 自定义板：Core DEV KIT 的 SCCB 是 SCL=GPIO8 / SDA=GPIO7，
# reset/pwdn/xclk 由摄像头模组自身提供
CONFIG_EXAMPLE_SELECT_CUSTOMIZED_DEV_BOARD=y
CONFIG_EXAMPLE_ENABLE_MIPI_CSI_CAM_SENSOR=y
CONFIG_EXAMPLE_MIPI_CSI_SCCB_I2C_PORT=0
CONFIG_EXAMPLE_MIPI_CSI_SCCB_I2C_SCL_PIN=8
CONFIG_EXAMPLE_MIPI_CSI_SCCB_I2C_SDA_PIN=7
CONFIG_EXAMPLE_MIPI_CSI_CAM_SENSOR_RESET_PIN=-1
CONFIG_EXAMPLE_MIPI_CSI_CAM_SENSOR_PWDN_PIN=-1
CONFIG_EXAMPLE_MIPI_CSI_XCLK_PIN=-1
CONFIG_EXAMPLE_ENABLE_MIPI_CSI_CAM_MOTOR=n
CONFIG_EXAMPLE_CAMERA_VIDEO_BUFFER_NUMBER=2
```
