## esp32_vision/sdkconfig.defaults
```kconfig
CONFIG_IDF_TARGET="esp32s3"
CONFIG_ESPTOOLPY_FLASHSIZE_16MB=y
CONFIG_ESPTOOLPY_FLASHMODE_QIO=y
CONFIG_ESPTOOLPY_FLASHFREQ_80M=y
CONFIG_PARTITION_TABLE_CUSTOM=y
CONFIG_PARTITION_TABLE_CUSTOM_FILENAME="partitions.csv"

# Octal 8MB PSRAM（N16R8 必须）
CONFIG_SPIRAM=y
CONFIG_SPIRAM_MODE_OCT=y
# 80MHz：IDF 5.3 无 120M 选项，写 120M 会被静默忽略而退回 40M（性能减半）
CONFIG_SPIRAM_SPEED_80M=y
CONFIG_SPIRAM_MALLOC_ALWAYSINTERNAL=4096
CONFIG_SPIRAM_TRY_ALLOCATE_WIFI_LWIP=y

# 性能
CONFIG_ESP_DEFAULT_CPU_FREQ_MHZ_240=y
CONFIG_FREERTOS_HZ=1000
CONFIG_ESP_MAIN_TASK_STACK_SIZE=6144
CONFIG_ESP_TASK_WDT_TIMEOUT_S=10

# WiFi 吞吐（图传大流量）
CONFIG_ESP_WIFI_STATIC_RX_BUFFER_NUM=32
CONFIG_ESP_WIFI_DYNAMIC_RX_BUFFER_NUM=64
CONFIG_ESP_WIFI_TX_BA_WIN=16
CONFIG_LWIP_UDP_RECVMBOX_SIZE=16

# 摄像头大帧缓冲
CONFIG_LWIP_SO_SNDBUF=y
CONFIG_LWIP_IP_FRAG=y
```
